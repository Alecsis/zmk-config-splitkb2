## config/boards/shields/caldera/Kconfig.defconfig
```kconfig
if SHIELD_SPLITKV_LEFT

config ZMK_KEYBOARD_NAME
    default "splitKV"

config ZMK_SPLIT_ROLE_CENTRAL
    default y

endif

if SHIELD_splitKV_left || SHIELD_splitKV_right

config ZMK_SPLIT
    default y

endif
```
